//
// OneBitDisplay library demo
//
// Demonstrates how to use virtual displays
// these allow you to create a display of any size in memory
// and draw it across multiple physical displays
//
//#include <random.h>
#include <OneBitDisplay.h>
OBDISP obLeft;
OBDISP obRight;
OBDISP obVirt;

// define a 256x64 framebuffer
static uint8_t ucBackBuffer[2048];

// Toaster animation images
const uint8_t toastermask0[] = {
  0x00, 0x00, 0x00, 0x00, 0x00, 0x10, 0x00, 0x00,
  0x00, 0x20, 0x00, 0x00, 0x00, 0x88, 0x00, 0x00,
  0x00, 0x10, 0x00, 0x00, 0x00, 0x43, 0xF8, 0x00,
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  0x01, 0xB0, 0x00, 0x00, 0x00, 0x00, 0x00, 0x00 };
const uint8_t toastermask1[] = {
  0x00, 0x00, 0x00, 0x00, 0x00, 0x00, 0x00, 0x00,
  0x00, 0x00, 0x00, 0x00, 0x00, 0x00, 0x00, 0x00,
  0x00, 0x00, 0x00, 0x00, 0x00, 0x43, 0xF8, 0x00,
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  0x01, 0xB0, 0x00, 0x00, 0x00, 0x00, 0x00, 0x00 };
const uint8_t toastermask2[] = {
  0x00, 0x00, 0x00, 0x00, 0x00, 0x00, 0x00, 0x00,
  0x00, 0x00, 0x00, 0x00, 0x00, 0x00, 0x00, 0x00,
  0x00, 0x00, 0x00, 0x00, 0x00, 0x03, 0xF8, 0x00,
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  0x01, 0xB0, 0x00, 0x00, 0x00, 0x00, 0x00, 0x00 };
  const uint8_t toaster0[] = {
  0x00, 0x30, 0x00, 0x00, 0x00, 0xE8, 0x00, 0x00,
  0x01, 0xD8, 0x00, 0x00, 0x03, 0x74, 0xF0, 0x00,
  0x07, 0xEF, 0xFE, 0x00, 0x07, 0xBC, 0x07, 0x80,
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  0x06, 0x4E, 0x00, 0x00, 0x01, 0xF0, 0x00, 0x00 };
 const uint8_t toaster1[] = {
  0x00, 0x00, 0x00, 0x00, 0x00, 0x00, 0x00, 0x00,
  0x00, 0x00, 0x00, 0x00, 0x00, 0x30, 0xF0, 0x00,
  0x00, 0xF7, 0xFE, 0x00, 0x01, 0xBC, 0x07, 0x80,
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  0x06, 0x4E, 0x00, 0x00, 0x01, 0xF0, 0x00, 0x00 };
 const uint8_t toaster2[] = {
  0x00, 0x00, 0x00, 0x00, 0x00, 0x00, 0x00, 0x00,
  0x00, 0x00, 0x00, 0x00, 0x00, 0x00, 0xF0, 0x00,
  0x00, 0x07, 0xFE, 0x00, 0x00, 0x3C, 0x07, 0x80,
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  0x06, 0x4E, 0x00, 0x00, 0x01, 0xF0, 0x00, 0x00 };
uint8_t * toasters[] = {(uint8_t *)toaster0, (uint8_t *)toaster1, (uint8_t *)toaster2, (uint8_t *)toaster1};
uint8_t * masks[] = {(uint8_t *)toastermask0, (uint8_t *)toastermask1, (uint8_t *)toastermask2, (uint8_t *)toastermask1};

void setup() {
int rc;
//int obdI2CInit(OBDISP *pOBD, int iType, int iAddr, int bFlip, int bInvert, int bWire, int iSDAPin, int iSCLPin, int iResetPin, int32_t iSpeed);
// Create a virtual display (memory only)
  obdCreateVirtualDisplay(&obVirt, 256, 64, ucBackBuffer);
// Initialize 2 physical OLED displays
// In this case, they are defined on the W600-PICO using bit banging
// Change the SDA and SCL pin definitions to match your setup
rc = obdI2CInit(&obLeft, OLED_128x64, -1, 0, 0,0,WM_IO_PB_12, WM_IO_PA_00,-1,1200000L);
rc = obdI2CInit(&obRight, OLED_128x64, -1, 0, 0,0,WM_IO_PB_11, WM_IO_PA_00,-1,1200000L);
  if (rc != OLED_NOT_FOUND)
  {
    char *msgs[] = {(char *)"SSD1306 @ 0x3C", (char *)"SSD1306 @ 0x3D",(char *)"SH1106 @ 0x3C",(char *)"SH1106 @ 0x3D"};
    obdFill(&obLeft, OBD_WHITE, 1);
    obdWriteString(&obLeft,0,0,0,msgs[rc], FONT_8x8, OBD_BLACK, 1);
    delay(2000);
  }
}
#define NUM_SPRITES 10
void loop() {
int i, x, y;
char szTemp[32];
unsigned long ms;
int xpos[NUM_SPRITES], ypos[NUM_SPRITES], index[NUM_SPRITES], velocity[NUM_SPRITES];

  obdFill(&obLeft, OBD_WHITE, 1);
  obdWriteString(&obLeft,0,16,0,(char *)"ss_oled Demo", FONT_8x8, OBD_BLACK, 1);
  obdWriteString(&obLeft,0,0,1,(char *)"Written by Larry Bank", FONT_6x8, OBD_WHITE, 1);
  obdWriteString(&obLeft,0,0,3,(char *)"**Demo**", FONT_16x32, OBD_BLACK, 1);
  delay(2000);

// Sprites
// generate random starting positions, speed and animation frame index
  for (i=0; i<NUM_SPRITES; i++)
  {
    xpos[i] = 4*((rand()&255) +31);
    ypos[i] = 4*((rand()&63) - 31);
    index[i] = rand() & 3;
    velocity[i] = 1+(rand() & 3);
  }
  while (1)
  {
    obdFill(&obVirt, OBD_WHITE, 0); // erase the virtual display
    for (i=0; i<NUM_SPRITES; i++)
    {
      int x, y;
      obdDrawSprite(&obVirt,masks[index[i] & 3], 32, 32, 4, xpos[i]>>2, ypos[i]>>2, 0);
      obdDrawSprite(&obVirt,toasters[index[i] & 3], 32, 32, 4, xpos[i]>>2, ypos[i]>>2, 1);
      xpos[i]-= velocity[i];
      ypos[i]+= velocity[i];
      index[i]++;
      x = xpos[i] >> 2; y = ypos[i] >> 2;
      if (x < -31 || y >= 64)
      {
        xpos[i] = 4*((rand()&255) + 31);
        ypos[i] = 4*((rand()&63) - 31);
      }
    }
    // Show the left half of the virtual display on the left OLED
    obdDumpWindow(&obVirt, &obLeft,0,0,0,0,128,64);
    // and the right half on the right OLED
    obdDumpWindow(&obVirt, &obRight,128,0,0,0,128,64);
  } // while (1)
} /* main() */
